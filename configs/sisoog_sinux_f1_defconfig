## package/rtl8188eus/Config.in
```kconfig
config BR2_PACKAGE_RTL8188EUS
	bool "rtl8188eus"
	depends on BR2_LINUX_KERNEL
	help
	  A standalone driver for the RTL8188EUS USB Wi-Fi adapter.

	  Make sure your target kernel has the CONFIG_WIRELESS_EXT
	  config option enabled.

	  Note: this package needs a firmware loading mechanism to load
	  the binary blob for the chip to work.

	  https://github.com/aircrack-ng/rtl8188eus

comment "rtl8188eu needs a Linux kernel to be built"
	depends on !BR2_LINUX_KERNEL
```
